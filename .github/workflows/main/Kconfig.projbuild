## .github/workflows/main/Kconfig.projbuild
```kconfig
menu "Dashboard Config"

    config COUNTDOWN_DEFAULT_SEC
        int "Countdown default duration (seconds)"
        default 300
        range 1 86400
        help
            Default one-shot countdown duration in seconds.
            This value is used when no "cd_seconds" key exists in NVS.
            You can override it at runtime by writing to NVS directly.
            Examples: 60=1min  300=5min  600=10min  3600=1hr

endmenu
```

## .github/workflows/sdkconfig.defaults
```kconfig
# ── Target ────────────────────────────────────────────────────────────────────
CONFIG_IDF_TARGET="esp32s3"

# ── Flash ─────────────────────────────────────────────────────────────────────
CONFIG_ESPTOOLPY_FLASHSIZE_16MB=y
CONFIG_ESPTOOLPY_FLASHSIZE="16MB"
CONFIG_ESPTOOLPY_FLASHFREQ_80M=y
CONFIG_ESPTOOLPY_FLASHMODE_QIO=y
CONFIG_PARTITION_TABLE_CUSTOM=y
CONFIG_PARTITION_TABLE_CUSTOM_FILENAME="partitions/partitions.csv"

# ── Crystal & CPU ─────────────────────────────────────────────────────────────
CONFIG_ESP32S3_DEFAULT_CPU_FREQ_240=y
CONFIG_ESP32S3_DEFAULT_CPU_FREQ_MHZ=240
CONFIG_XTAL_FREQ_40=y
CONFIG_XTAL_FREQ=40

# ── PSRAM (Octal 8 MB AP_3v3) ─────────────────────────────────────────────────
CONFIG_SPIRAM=y
CONFIG_SPIRAM_MODE_OCT=y
CONFIG_SPIRAM_SPEED_80M=y
CONFIG_SPIRAM_BOOT_INIT=y
CONFIG_SPIRAM_USE_MALLOC=y
CONFIG_SPIRAM_MALLOC_ALWAYSINTERNAL=16384
CONFIG_SPIRAM_TRY_ALLOCATE_WIFI_LWIP=y

# ── Wi-Fi ─────────────────────────────────────────────────────────────────────
CONFIG_ESP_WIFI_STATIC_RX_BUFFER_NUM=10
CONFIG_ESP_WIFI_DYNAMIC_RX_BUFFER_NUM=32
CONFIG_ESP_WIFI_TX_BUFFER_TYPE_DYNAMIC=y

# ── Bluetooth 5 LE ────────────────────────────────────────────────────────────
CONFIG_BT_ENABLED=y
CONFIG_BT_NIMBLE_ENABLED=y
CONFIG_BT_NIMBLE_50_FEATURE_SUPPORT=y
CONFIG_BT_NIMBLE_LL_CFG_FEAT_LE_2M_PHY=y
CONFIG_BT_NIMBLE_LL_CFG_FEAT_LE_CODED_PHY=y

# ── FreeRTOS ──────────────────────────────────────────────────────────────────
CONFIG_FREERTOS_HZ=1000
CONFIG_FREERTOS_UNICORE=n

# ── Logging ───────────────────────────────────────────────────────────────────
CONFIG_LOG_DEFAULT_LEVEL_INFO=y
CONFIG_LOG_MAXIMUM_LEVEL_DEBUG=y

# ── HTTP / TLS ────────────────────────────────────────────────────────────────
CONFIG_ESP_HTTP_CLIENT_ENABLE_HTTPS=y
CONFIG_MBEDTLS_CERTIFICATE_BUNDLE=y
```
