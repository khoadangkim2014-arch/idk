#include "display.h"
#include "board_config.h"
#include "driver/i2c.h"
#include "esp_log.h"
#include <string.h>
#include <stdio.h>
#include <stdarg.h>

static const char *TAG = "DISPLAY";

/* ── Framebuffer ─────────────────────────────────────────── */
static uint8_t fb[DISPLAY_WIDTH * DISPLAY_HEIGHT / 8];
static int cursor_x = 0, cursor_y = 0;

/* ── Minimal 6×8 ASCII font (space → ~) ─────────────────── */
static const uint8_t font6x8[][6] = {
    {0x00,0x00,0x00,0x00,0x00,0x00}, /* ' ' */
    {0x00,0x00,0x5F,0x00,0x00,0x00}, /* '!' */
    {0x00,0x07,0x00,0x07,0x00,0x00}, /* '"' */
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    {0x44,0x64,0x54,0x4C,0x44,0x00}, /* 'z' */
};

/* ── I2C helpers ─────────────────────────────────────────── */
static esp_err_t ssd1306_cmd(uint8_t cmd) {
    uint8_t buf[2] = {0x00, cmd};
    return i2c_master_write_to_device(DISPLAY_I2C_PORT, DISPLAY_I2C_ADDR,
                                      buf, 2, pdMS_TO_TICKS(10));
}

static esp_err_t ssd1306_data(const uint8_t *data, size_t len) {
    uint8_t *buf = malloc(len + 1);
    if (!buf) return ESP_ERR_NO_MEM;
    buf[0] = 0x40;
    memcpy(buf + 1, data, len);
    esp_err_t ret = i2c_master_write_to_device(DISPLAY_I2C_PORT, DISPLAY_I2C_ADDR,
                                               buf, len + 1, pdMS_TO_TICKS(50));
    free(buf);
    return ret;
}

/* ── Public API ──────────────────────────────────────────── */
void display_init(void) {
    i2c_config_t cfg = {
        .mode             = I2C_MODE_MASTER,
        .sda_io_num       = DISPLAY_PIN_SDA,
        .scl_io_num       = DISPLAY_PIN_SCL,
        .sda_pullup_en    = GPIO_PULLUP_ENABLE,
        .scl_pullup_en    = GPIO_PULLUP_ENABLE,
        .master.clk_speed = DISPLAY_I2C_FREQ_HZ,
    };
    ESP_ERROR_CHECK(i2c_param_config(DISPLAY_I2C_PORT, &cfg));
    ESP_ERROR_CHECK(i2c_driver_install(DISPLAY_I2C_PORT, I2C_MODE_MASTER, 0, 0, 0));

    static const uint8_t init_seq[] = {
        0xAE,             /* display off */
        0xD5, 0x80,       /* clock div */
        0xA8, 0x3F,       /* multiplex 64 */
        0xD3, 0x00,       /* display offset */
        0x40,             /* start line 0 */
        0x8D, 0x14,       /* charge pump on */
        0x20, 0x00,       /* horizontal addressing */
        0xA1,             /* seg remap */
        0xC8,             /* com scan dec */
        0xDA, 0x12,       /* com pins */
        0x81, 0xCF,       /* contrast */
        0xD9, 0xF1,       /* precharge */
        0xDB, 0x40,       /* vcom deselect */
        0xA4,             /* display follows RAM */
        0xA6,             /* normal (not inverted) */
        0xAF,             /* display on */
    };
    for (size_t i = 0; i < sizeof(init_seq); i++) ssd1306_cmd(init_seq[i]);
    display_clear();
    display_flush();
    ESP_LOGI(TAG, "SSD1306 128x64 ready");
}

void display_clear(void) { memset(fb, 0, sizeof(fb)); }

void display_flush(void) {
    ssd1306_cmd(0x21); ssd1306_cmd(0); ssd1306_cmd(127);
    ssd1306_cmd(0x22); ssd1306_cmd(0); ssd1306_cmd(7);
    ssd1306_data(fb, sizeof(fb));
}

void display_draw_pixel(int x, int y, bool on) {
    if (x < 0 || x >= DISPLAY_WIDTH || y < 0 || y >= DISPLAY_HEIGHT) return;
    if (on) fb[x + (y / 8) * DISPLAY_WIDTH] |=  (1 << (y & 7));
    else    fb[x + (y / 8) * DISPLAY_WIDTH] &= ~(1 << (y & 7));
}

void display_draw_hline(int x, int y, int len) {
    for (int i = 0; i < len; i++) display_draw_pixel(x + i, y, true);
}

void display_draw_vline(int x, int y, int len) {
    for (int i = 0; i < len; i++) display_draw_pixel(x, y + i, true);
}

void display_draw_rect(int x, int y, int w, int h, bool filled) {
    if (filled) {
        for (int dy = 0; dy < h; dy++)
            for (int dx = 0; dx < w; dx++)
                display_draw_pixel(x + dx, y + dy, true);
    } else {
        display_draw_hline(x, y,       w);
        display_draw_hline(x, y+h-1,   w);
        display_draw_vline(x,     y,   h);
        display_draw_vline(x+w-1, y,   h);
    }
}

void display_set_cursor(int x, int y) { cursor_x = x; cursor_y = y; }

void display_print(const char *str) {
    while (*str) {
        char c = *str++;
        if (c == '\n') { cursor_x = 0; cursor_y += 8; continue; }
        int idx = c - ' ';
        if (idx < 0 || idx >= (int)(sizeof(font6x8)/6)) idx = 0;
        for (int col = 0; col < 6; col++) {
            uint8_t bits = font6x8[idx][col];
            for (int row = 0; row < 8; row++)
                display_draw_pixel(cursor_x + col, cursor_y + row, (bits >> row) & 1);
        }
        cursor_x += 6;
        if (cursor_x + 6 > DISPLAY_WIDTH) { cursor_x = 0; cursor_y += 8; }
    }
}

void display_printf(const char *fmt, ...) {
    char buf[128];
    va_list args;
    va_start(args, fmt);
    vsnprintf(buf, sizeof(buf), fmt, args);
    va_end(args);
    display_print(buf);
}

void display_draw_scrolling_text(const char *text, int y, int *scroll_pos) {
    int len = strlen(text);
    int px  = DISPLAY_WIDTH - (*scroll_pos % (len * 6 + DISPLAY_WIDTH));
    display_set_cursor(px, y);
    display_print(text);
    (*scroll_pos)++;
}

void display_draw_progress_bar(int x, int y, int w, int h, int percent) {
    display_draw_rect(x, y, w, h, false);
    int fill = (w - 2) * percent / 100;
    display_draw_rect(x + 1, y + 1, fill, h - 2, true);
}

void display_invert(bool on) { ssd1306_cmd(on ? 0xA7 : 0xA6); }

/*
 * display_draw_battery()
 *
 * Renders a classic battery icon in the top-right corner at fixed position
 * x=93, y=1  so it always sits inside the 10-px header bar.
 *
 * Layout (12 px wide × 7 px tall):
 *   [=======  ]  ← outer shell (11×7) + nub (1×3) on the right
 *    ^^^^^^^^     filled portion proportional to percent
 *
 * Followed by "XX%" text starting at x=106, y=1 (fits 3 chars in 6×8 font).
 * Special case: percent <= 10 → blink (every other call inverts fill area).
 */
void display_draw_battery(int percent) {
    if (percent < 0)   percent = 0;
    if (percent > 100) percent = 100;

    /* Fixed top-right position */
    const int BX = 93;  /* battery body left edge */
    const int BY = 1;   /* battery body top edge  */
    const int BW = 11;  /* body width  */
    const int BH = 7;   /* body height */

    /* Outer shell */
    display_draw_rect(BX, BY, BW, BH, false);

    /* Nub on right side (2 px wide, 3 px tall, centred vertically) */
    display_draw_vline(BX + BW,     BY + 2, 3);
    display_draw_vline(BX + BW + 1, BY + 2, 3);

    /* Fill interior proportional to charge */
    int inner_w = BW - 2;                       /* 9 px usable */
    int fill    = inner_w * percent / 100;
    if (fill > 0)
        display_draw_rect(BX + 1, BY + 1, fill, BH - 2, true);

    /* Low-battery blink: erase fill on odd ticks */
    static uint8_t blink_tick = 0;
    if (percent <= 10) {
        blink_tick ^= 1;
        if (blink_tick)
            display_draw_rect(BX + 1, BY + 1, inner_w, BH - 2, false); /* erase */
    }
}
